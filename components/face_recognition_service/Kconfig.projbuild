## components/face_recognition_service/Kconfig.projbuild
```kconfig
menu "Face Recognition Service"

    config FACE_RECOGNITION_DB_PATH
        string "Face database file path"
        default "/spiffs/face_db.bin"
        help
            Path where enrolled face features will be persisted.

endmenu
```

## components/network_service/Kconfig.projbuild
```kconfig
menu "ESP32-S31 camera network"

config S31_CAM_WIFI_AP_SSID
    string "Camera Wi-Fi hotspot name"
    default "ESP32-S31-CAM"

config S31_CAM_WIFI_AP_PASSWORD
    string "Camera Wi-Fi hotspot password"
    default "esp32s31"
    help
        Must contain at least 8 characters. Leave empty only for an open hotspot.

config S31_CAM_WIFI_AP_CHANNEL
    int "Camera Wi-Fi channel"
    range 1 13
    default 6

config S31_CAM_OTA_TOKEN
    string "OTA upload token"
    default "s31cam-ota"
    help
        Required in the X-OTA-Token HTTP header. Change this before deploying
        devices outside a trusted development LAN.

endmenu
```

## sdkconfig.defaults
```kconfig
CONFIG_IDF_TARGET="esp32s31"
CONFIG_ESPTOOLPY_FLASHSIZE_16MB=y
CONFIG_PARTITION_TABLE_CUSTOM=y
CONFIG_PARTITION_TABLE_CUSTOM_FILENAME="partitions.csv"
CONFIG_BOOTLOADER_APP_ROLLBACK_ENABLE=y
CONFIG_S31_CAM_WIFI_AP_SSID="ESP32-S31-CAM"
CONFIG_S31_CAM_WIFI_AP_PASSWORD="esp32s31"
CONFIG_S31_CAM_WIFI_AP_CHANNEL=6
CONFIG_S31_CAM_OTA_TOKEN="s31cam-ota"
CONFIG_SPIRAM=y
CONFIG_BSP_LCD_RGB_BUFFER_NUMS=2
CONFIG_BSP_LCD_RGB_REFRESH_AUTO=y
CONFIG_BSP_DISPLAY_LVGL_AVOID_TEAR=y
CONFIG_BSP_DISPLAY_LVGL_DIRECT_MODE=y
CONFIG_CAMERA_OV3660=y
CONFIG_CAMERA_OV3660_DVP_RGB565_BE_240X240_24FPS=y
CONFIG_CAMERA_OV3660_DVP_RGB565_BE_640X480_10FPS=y
CONFIG_CAMERA_OV3660_DVP_JPEG_1280X720_12FPS=y
CONFIG_CAMERA_OV3660_DVP_DEFAULT_FMT_RGB565_BE_640X480_10FPS=y
CONFIG_ESP_VIDEO_ENABLE_DVP_VIDEO_DEVICE=y
CONFIG_FLASH_HUMAN_FACE_DETECT_MSRMNP_S8_V1=y
CONFIG_FLASH_ESPDET_PICO_224_224_FACE=n
CONFIG_HUMAN_FACE_DETECT_MSRMNP_S8_V1=y
CONFIG_HUMAN_FACE_DETECT_MODEL_IN_FLASH_RODATA=y
CONFIG_FLASH_HUMAN_FACE_FEAT_MFN_S8_V1=y
CONFIG_HUMAN_FACE_FEAT_MFN_S8_V1=y
CONFIG_HUMAN_FACE_FEAT_MODEL_IN_FLASH_RODATA=y
CONFIG_FACE_RECOGNITION_DB_PATH="/spiffs/face_db.bin"
CONFIG_BSP_SPIFFS_FORMAT_ON_MOUNT_FAIL=y
CONFIG_BSP_SPIFFS_PARTITION_LABEL="app_data"
CONFIG_MBEDTLS_CERTIFICATE_BUNDLE=y
CONFIG_MBEDTLS_CERTIFICATE_BUNDLE_DEFAULT_FULL=y
```
